## conf/layer.conf
```bitbake
# We have a conf and classes directory, add to BBPATH
BBPATH .= ":${LAYERDIR}"

# We have recipes-* directories, add to BBFILES
BBFILES += "${LAYERDIR}/recipes-*/*/*.bb \
	${LAYERDIR}/recipes-*/*/*.bbappend"

BBFILE_COLLECTIONS += "zynqberry"
BBFILE_PATTERN_zynqberry = "^${LAYERDIR}/"
BBFILE_PRIORITY_zynqberry = "6"
```

## conf/machine/zynqberry.conf
```bitbake
#@TYPE: Machine
#@NAME: zynqberry
#@DESCRIPTION: Machine support for zynqberry. 

require conf/machine/include/tune-zynq.inc
require conf/machine/include/machine-xilinx-default.inc
require conf/machine/include/machine-xilinx-board.inc

# u-boot configuration
UBOOT_MACHINE = "zynqberry_config"

SERIAL_CONSOLE = "115200 ttyPS0"

IMAGE_BOOT_FILES += "boot.bin zynqberry.dtb"
```
